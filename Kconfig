## Kconfig
```kconfig
menuconfig PAW3222
    bool "PAW3222 mouse optical sensor"
    select SPI
    help
      Enable PAW3222 mouse optical sensor.

config PAW3222_REPORT_INTERVAL_MS
    int "PAW3222 motion report interval in milliseconds"
    default 15
    range 1 100
    help
      Interval in milliseconds between motion reads while the sensor is active.

config ZMK_PAW3222_CUSTOM_SETTINGS
    bool "Enable PAW3222 runtime settings for DYA Studio"
    depends on PAW3222
    depends on ZMK_CUSTOM_SETTINGS
    help
      Expose PAW3222 runtime settings through zmk-feature-custom-settings.
      The settings are available under the "cormoran__paw3222" subsystem,
      can be changed through Studio RPC, and are persisted by the custom
      settings module.
```
